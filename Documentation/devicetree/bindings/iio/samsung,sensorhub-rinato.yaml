## Documentation/devicetree/bindings/iio/samsung,sensorhub-rinato.yaml
```yaml
# SPDX-License-Identifier: (GPL-2.0 OR BSD-2-Clause)
%YAML 1.2
---
$id: http://devicetree.org/schemas/iio/samsung,sensorhub-rinato.yaml#
$schema: http://devicetree.org/meta-schemas/core.yaml#

title: Samsung Sensorhub driver

maintainers:
  - Jonathan Cameron <jic23@kernel.org>

description: |
  Sensorhub is a MCU which manages several sensors and also plays the role
  of a virtual sensor device.

properties:
  compatible:
    enum:
      - samsung,sensorhub-rinato
      - samsung,sensorhub-thermostat

  reg:
    maxItems: 1

  interrupts:
    maxItems: 1

  ap-mcu-gpios:
    maxItems: 1
    description:
      Application Processor to sensorhub line - used during communication

  mcu-ap-gpios:
    maxItems: 1
    description:
      Sensorhub to Application Processor - used during communication

  mcu-reset-gpios:
    maxItems: 1
    description:
      Reset the sensorhub.

  vdd-supply:
    description:
      Supply the sensorhub firmware needs to run.

  hrm-supply:
    description:
      Supply of the heart rate monitor front end.

required:
  - compatible
  - reg
  - interrupts
  - ap-mcu-gpios
  - mcu-ap-gpios
  - mcu-reset-gpios

allOf:
  - $ref: /schemas/spi/spi-peripheral-props.yaml#
  - if:
      properties:
        compatible:
          contains:
            const: samsung,sensorhub-rinato
    then:
      required:
        - vdd-supply

unevaluatedProperties: false

examples:
  - |
    spi {
        #address-cells = <1>;
        #size-cells = <0>;

        sensorhub@0 {
            compatible = "samsung,sensorhub-rinato";
            reg = <0>;
            spi-max-frequency = <5000000>;
            interrupt-parent = <&gpx0>;
            interrupts = <2 0>;
            ap-mcu-gpios = <&gpx0 0 0>;
            mcu-ap-gpios = <&gpx0 4 0>;
            mcu-reset-gpios = <&gpx0 5 0>;
            vdd-supply = <&ldo23_reg>;
            hrm-supply = <&ldo24_reg>;
        };
    };
...
```

## Documentation/devicetree/bindings/leds/irled/samsung,ice40-ir-tx.yaml
```yaml
# SPDX-License-Identifier: GPL-2.0-only OR BSD-2-Clause
%YAML 1.2
---
$id: http://devicetree.org/schemas/leds/irled/samsung,ice40-ir-tx.yaml#
$schema: http://devicetree.org/meta-schemas/core.yaml#

title: Samsung iCE40 FPGA IR transmitter

maintainers:
  - Davids Paskevics <davids.paskevics@gmail.com>

description:
  IR transmitter built from a Lattice iCE40 FPGA running Samsung's IR
  bitstream, as found in the Samsung Gear 2. The FPGA sits on a bit-banged
  I2C bus whose SCL and SDA lines are wired to its SPI slave configuration
  port, so the bitstream is loaded over the same two lines before the FPGA
  answers as an I2C device. Its interrupt line is low while a frame is
  transmitted.

properties:
  compatible:
    const: samsung,ice40-ir-tx

  reg:
    maxItems: 1

  interrupts:
    maxItems: 1
    description: Busy line, rising at the end of a transmission.

  clocks:
    maxItems: 1
    description: System clock of the FPGA design.

  power-supply:
    description: Supply of the IR LED.

  reset-gpios:
    maxItems: 1
    description: FPGA CRESET_B line.

  cdone-gpios:
    maxItems: 1
    description: FPGA CDONE line.

  ss-gpios:
    maxItems: 1
    description:
      FPGA SPI_SS_B line, which also resets the design once it is configured.

  firmware-name:
    maxItems: 1
    description: Name of the bitstream file, if not samsung/ice40_irda.fw.

required:
  - compatible
  - reg
  - interrupts
  - clocks
  - reset-gpios
  - cdone-gpios
  - ss-gpios

additionalProperties: false

examples:
  - |
    #include <dt-bindings/gpio/gpio.h>
    #include <dt-bindings/interrupt-controller/irq.h>

    i2c {
        #address-cells = <1>;
        #size-cells = <0>;

        ir-transmitter@50 {
            compatible = "samsung,ice40-ir-tx";
            reg = <0x50>;
            interrupt-parent = <&gpx1>;
            interrupts = <0 IRQ_TYPE_EDGE_RISING>;
            clocks = <&pmu_system_controller 0>;
            power-supply = <&ldo17_reg>;
            reset-gpios = <&gpx2 5 GPIO_ACTIVE_LOW>;
            cdone-gpios = <&gpx2 4 GPIO_ACTIVE_HIGH>;
            ss-gpios = <&gpe0 6 GPIO_ACTIVE_LOW>;
        };
    };
```

## Documentation/devicetree/bindings/media/i2c/samsung,s5k8b1.yaml
```yaml
# SPDX-License-Identifier: GPL-2.0-only OR BSD-2-Clause
%YAML 1.2
---
$id: http://devicetree.org/schemas/media/i2c/samsung,s5k8b1.yaml#
$schema: http://devicetree.org/meta-schemas/core.yaml#

title: Samsung S5K8B1(YX) raw image sensor

maintainers:
  - Davids Paskevics <davids.paskevics@gmail.com>

description:
  S5K8B1(YX) is a raw image sensor with a MIPI CSI-2 image data interface
  and a CCI (I2C compatible) control bus.

properties:
  compatible:
    const: samsung,s5k8b1

  reg:
    maxItems: 1

  clocks:
    maxItems: 1

  clock-names:
    items:
      - const: extclk

  clock-frequency:
    default: 24000000
    description: Frequency to run extclk at.

  xshutdown-gpios:
    maxItems: 1
    description: GPIO connected to the active low XSHUTDOWN pin.

  vdda-supply:
    description: Analogue voltage supply (typically 2.8 V).

  vddio-supply:
    description: I/O voltage supply (typically 1.8 V).

  vddd-supply:
    description: Digital core voltage supply (typically 1.2 V).

  afvdd-supply:
    description: Lens actuator voltage supply (typically 2.8 V).

  port:
    $ref: /schemas/graph.yaml#/$defs/port-base
    additionalProperties: false

    properties:
      endpoint:
        $ref: /schemas/media/video-interfaces.yaml#
        unevaluatedProperties: false

        properties:
          data-lanes:
            minItems: 1
            maxItems: 2

        required:
          - data-lanes

required:
  - compatible
  - reg
  - clocks
  - clock-names
  - xshutdown-gpios
  - vdda-supply
  - vddio-supply
  - vddd-supply
  - afvdd-supply
  - port

additionalProperties: false

examples:
  - |
    #include <dt-bindings/clock/exynos3250.h>
    #include <dt-bindings/gpio/gpio.h>

    i2c {
        #address-cells = <1>;
        #size-cells = <0>;

        image-sensor@6a {
            compatible = "samsung,s5k8b1";
            reg = <0x6a>;
            clocks = <&cmu CLK_SCLK_CAM1>;
            clock-names = "extclk";
            clock-frequency = <24000000>;
            xshutdown-gpios = <&gpm2 3 GPIO_ACTIVE_LOW>;
            vdda-supply = <&ldo13_reg>;
            vddio-supply = <&ldo21_reg>;
            vddd-supply = <&ldo22_reg>;
            afvdd-supply = <&ldo18_reg>;

            port {
                endpoint {
                    remote-endpoint = <&csis0_ep>;
                    data-lanes = <1>;
                };
            };
        };
    };
```

## Documentation/devicetree/bindings/media/samsung,exynos3250-fimc-is.yaml
```yaml
# SPDX-License-Identifier: GPL-2.0-only OR BSD-2-Clause
%YAML 1.2
---
$id: http://devicetree.org/schemas/media/samsung,exynos3250-fimc-is.yaml#
$schema: http://devicetree.org/meta-schemas/core.yaml#

title: Samsung Exynos3250 SoC Imaging Subsystem (FIMC-IS)

maintainers:
  - Davids Paskevics <davids.paskevics@gmail.com>

description:
  The Exynos3250 FIMC-IS is a cut down version of the Exynos5 FIMC-IS. Its
  firmware runs on a dedicated ARM Cortex-A5 and drives the ISP, DRC, FD and
  scaler blocks, as well as the image sensors on the ISP I2C bus. The
  FIMC-LITE and MIPI CSIS instances feeding it are described as its child
  nodes, and the FIMC-IS acts as the media device for all of them.

properties:
  compatible:
    const: samsung,exynos3250-fimc-is

  reg:
    maxItems: 1
    description: MCUCTL registers, the mailbox to the firmware.

  ranges: true

  '#address-cells':
    const: 1

  '#size-cells':
    const: 1

  interrupts:
    items:
      - description: MCUCTL interrupt, the firmware's messages
      - description: second MCUCTL interrupt

  clocks:
    maxItems: 17

  clock-names:
    items:
      - const: isp
      - const: mcu_isp
      - const: isp_divmpwm
      - const: isp_div0
      - const: isp_div1
      - const: mcu_isp_div0
      - const: mcu_isp_div1
      - const: cam1
      - const: mout_aclk400_mcuisp_sub
      - const: div_aclk400_mcuisp
      - const: mout_aclk400_mcuisp
      - const: mout_aclk266_0
      - const: mout_aclk266
      - const: div_aclk266
      - const: mout_aclk266_sub
      - const: div_mpll_pre
      - const: fin_pll

  memory-region:
    maxItems: 1
    description:
      Memory to load the firmware to. The firmware has to be placed at a
      64 MiB aligned address.

  pinctrl-0: true

  pinctrl-names:
    items:
      - const: default

  power-domains:
    maxItems: 1

  samsung,pmu-syscon:
    $ref: /schemas/types.yaml#/definitions/phandle
    description:
      Power Management Unit (PMU) system controller interface, used to
      power, start and reset the ISP.

patternProperties:
  "^fimc-lite@[0-9a-f]+$":
    type: object
    $ref: samsung,exynos4212-fimc-lite.yaml#

  "^csis@[0-9a-f]+$":
    type: object
    $ref: samsung,exynos4210-csis.yaml#

  "^i2c-isp@[0-9a-f]+$":
    type: object
    $ref: /schemas/i2c/i2c-controller.yaml#
    unevaluatedProperties: false
    description:
      ISP I2C bus controller. The image sensors controlled by the firmware
      are its child nodes.

    properties:
      compatible:
        const: samsung,exynos4212-i2c-isp

      reg:
        maxItems: 1

      clocks:
        maxItems: 1

      clock-names:
        items:
          - const: i2c_isp

      pinctrl-0: true

      pinctrl-names:
        items:
          - const: default

    required:
      - compatible
      - reg
      - clocks
      - clock-names

required:
  - compatible
  - reg
  - '#address-cells'
  - '#size-cells'
  - clocks
  - clock-names
  - interrupts
  - ranges
  - samsung,pmu-syscon

additionalProperties: false

examples:
  - |
    #include <dt-bindings/clock/exynos3250.h>
    #include <dt-bindings/interrupt-controller/arm-gic.h>

    fimc-is@12180000 {
        compatible = "samsung,exynos3250-fimc-is";
        reg = <0x12180000 0x10000>;
        interrupts = <GIC_SPI 196 IRQ_TYPE_LEVEL_HIGH>,
                     <GIC_SPI 197 IRQ_TYPE_LEVEL_HIGH>;
        clocks = <&cmu_isp CLK_ISP>,
                 <&cmu_isp CLK_MCUISP>,
                 <&cmu_isp CLK_DIV_MPWM>,
                 <&cmu_isp CLK_DIV_ISP0>,
                 <&cmu_isp CLK_DIV_ISP1>,
                 <&cmu_isp CLK_DIV_MCUISP0>,
                 <&cmu_isp CLK_DIV_MCUISP1>,
                 <&cmu CLK_CAM1>,
                 <&cmu CLK_MOUT_ACLK_400_MCUISP_SUB>,
                 <&cmu CLK_DIV_ACLK_400_MCUISP>,
                 <&cmu CLK_MOUT_ACLK_400_MCUISP>,
                 <&cmu CLK_MOUT_ACLK_266_0>,
                 <&cmu CLK_MOUT_ACLK_266>,
                 <&cmu CLK_DIV_ACLK_266>,
                 <&cmu CLK_MOUT_ACLK_266_SUB>,
                 <&cmu CLK_DIV_MPLL_PRE>,
                 <&cmu CLK_FIN_PLL>;
        clock-names = "isp", "mcu_isp", "isp_divmpwm",
                      "isp_div0", "isp_div1",
                      "mcu_isp_div0", "mcu_isp_div1", "cam1",
                      "mout_aclk400_mcuisp_sub",
                      "div_aclk400_mcuisp",
                      "mout_aclk400_mcuisp",
                      "mout_aclk266_0", "mout_aclk266",
                      "div_aclk266", "mout_aclk266_sub",
                      "div_mpll_pre", "fin_pll";
        memory-region = <&fimc_is_mem>;
        power-domains = <&pd_isp>;
        samsung,pmu-syscon = <&pmu_system_controller>;
        #address-cells = <1>;
        #size-cells = <1>;
        ranges;

        fimc-lite@120a0000 {
            compatible = "samsung,exynos3250-fimc-lite";
            reg = <0x120a0000 0x1000>;
            interrupts = <GIC_SPI 198 IRQ_TYPE_LEVEL_HIGH>;
            clocks = <&cmu_isp CLK_LITE0>;
            clock-names = "flite";
            power-domains = <&pd_isp>;
        };

        csis@120c0000 {
            compatible = "samsung,exynos3250-csis";
            reg = <0x120c0000 0x4000>;
            interrupts = <GIC_SPI 165 IRQ_TYPE_LEVEL_HIGH>;
            clocks = <&cmu_isp CLK_CSIS0>;
            clock-names = "csis";
            bus-width = <2>;
            power-domains = <&pd_cam>;
            phys = <&mipi_phy 0>;
            phy-names = "csis";
            vddcore-supply = <&ldo6_reg>;
            vddio-supply = <&ldo6_reg>;
            #address-cells = <1>;
            #size-cells = <0>;

            port@3 {
                reg = <3>;

                csis0_ep: endpoint {
                    remote-endpoint = <&s5k8b1_ep>;
                    data-lanes = <1>;
                    samsung,csis-hs-settle = <16>;
                };
            };
        };

        i2c-isp@12130000 {
            compatible = "samsung,exynos4212-i2c-isp";
            reg = <0x12130000 0x100>;
            clocks = <&cmu_isp CLK_I2C0_ISP>;
            clock-names = "i2c_isp";
            pinctrl-names = "default";
            pinctrl-0 = <&fimc_is_i2c0>;
            #address-cells = <1>;
            #size-cells = <0>;
        };
    };
```

## Documentation/devicetree/bindings/sound/yamaha,ymu831.yaml
```yaml
# SPDX-License-Identifier: (GPL-2.0-only OR BSD-2-Clause)
%YAML 1.2
---
$id: http://devicetree.org/schemas/sound/yamaha,ymu831.yaml#
$schema: http://devicetree.org/meta-schemas/core.yaml#

title: Yamaha YMU831 audio hub CODEC

maintainers:
  - Davids Paskevics <davids.paskevics@gmail.com>

description:
  The Yamaha YMU831 is an audio CODEC with a class-D speaker amplifier,
  headphone, receiver and line outputs, analog and digital microphone
  inputs, headset detection and several DSPs. It is controlled over SPI.

allOf:
  - $ref: dai-common.yaml#
  - $ref: /schemas/spi/spi-peripheral-props.yaml#

properties:
  compatible:
    const: yamaha,ymu831

  reg:
    maxItems: 1

  interrupts:
    maxItems: 1
    description:
      Interrupt output, signalling headset detection and DSP events.

  clocks:
    items:
      - description: master clock (MCLK)

  clock-names:
    items:
      - const: mclk

  dvdd-supply:
    description:
      External supply for the digital core, used while the CODEC's internal
      digital LDO is off. Without it, the internal LDO is used throughout.

  mic1-bias-supply:
    description:
      External bias supply for microphone 1, enabled while the microphone is
      in use.

  yamaha,dio-ports:
    $ref: /schemas/types.yaml#/definitions/uint32-array
    description:
      The digital audio interface pins (0 for DIO0 to 2 for DIO2) the music,
      ext, voice and HiFi ports are wired to.
    items:
      enum: [0, 1, 2]
    minItems: 4
    maxItems: 4
    default: [0, 2, 1, 0]

  "#sound-dai-cells":
    const: 1
    description: |
      The digital audio interfaces:
        0: music port
        1: ext port
        2: voice port

required:
  - compatible
  - reg
  - "#sound-dai-cells"

unevaluatedProperties: false

examples:
  - |
    #include <dt-bindings/interrupt-controller/irq.h>

    spi {
        #address-cells = <1>;
        #size-cells = <0>;

        audio-codec@0 {
            compatible = "yamaha,ymu831";
            reg = <0>;
            spi-max-frequency = <10000000>;
            interrupt-parent = <&gpx1>;
            interrupts = <4 IRQ_TYPE_EDGE_FALLING>;
            clocks = <&pmu_system_controller 0>;
            clock-names = "mclk";
            dvdd-supply = <&codec_dvdd>;
            #sound-dai-cells = <1>;
        };
    };
```
